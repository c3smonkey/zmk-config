// ZMK Core Includes
#include <behaviors.dtsi>
#include <dt-bindings/zmk/keys.h>
#include <dt-bindings/zmk/bt.h>
#include <dt-bindings/zmk/outputs.h>

// control / command
#define CTR_CMD LC(LGUI)

// command / shift / control
#define SFI_CTR_CMD LS(LC(LGUI))

// control / command
#define CTR_CMD LC(LGUI)

#define XXX &none
#define ___ &trans

// Layers
#define L1 0
#define L2 1
#define Fn 2

// Meh key
#define MEH LS(LC(LALT))

// Behaviors Constants
#define TAPPING_TERM_MS 280
#define QUICK_TAP_MS 175
#define GLOBAL_QUICK_TAP_MS 150

// Combos Constants
#define COMBO_TERM_DEFAULT 30
#define COMBO_QUICK_TAP_MS 100

#include "behaviors.dtsi"
#include "macros.dtsi"
#include "combos.dtsi"
